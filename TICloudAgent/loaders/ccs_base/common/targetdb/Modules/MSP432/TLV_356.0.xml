# TLV_356.0 register map
Vendor: Texas Instruments
Peripheral module from a debugger description file (folder MSP432).
Registers are 32-bit, access not given, no defined reset value unless marked. A register's access mark holds for its fields unless they carry their own. Offsets are as the file gives them; lines under a group give offsets from that group; [hi:lo] are bit positions; {n}, {i} and the like mark numbered series; 'fields as' and 'values as' point back to an identical list; <NAME> marks a mode.

## TLV
0x00 TLV_CHECKSUM
0x04 DEVICE_INFO_TAG
0x08 DEVICE_INFO_LEN — Device Info Length
0x0C DEVICE_ID
0x10 HWREV — HW Revision
0x14 BCREV — Boot Code Revision
0x18 ROM_DRVLIB_REV — ROM Driver Library Revision
0x1C DIE_REC_TAG — Die Record Tag
0x20 DIE_REC_LEN — Die Record Length
0x24 DIE_XPOS — Die X-Position
0x28 DIE_YPOS — Die Y-Position
0x2C WAFER_ID
0x30 LOT_ID
0x40 TEST_RESULTS
0x44 CS_CAL_TAG — Clock System Calibration Tag
0x48 CS_CAL_LEN — Clock System Calibration Length
0x4C DCOIR_FCAL_RSEL04 — DCO IR mode: Frequency calibration for DCORSEL 0 to 4
0x50 DCOIR_FCAL_RSEL5 — DCO IR mode: Frequency calibration for DCORSEL 5
0x64 DCOIR_CONSTK_RSEL04 — DCO IR mode: DCO Constant (K) for DCORSEL 0 to 4
0x68 DCOIR_CONSTK_RSEL5 — DCO IR mode: DCO Constant (K) for DCORSEL 5
0x6C DCOER_FCAL_RSEL04 — DCO ER mode: Frequency calibration for DCORSEL 0 to 4
0x70 DCOER_FCAL_RSEL5 — DCO ER mode: Frequency calibration for DCORSEL 5
0x84 DCOER_CONSTK_RSEL04 — DCO ER mode: DCO Constant (K) for DCORSEL 0 to 4
0x88 DCOER_CONSTK_RSEL5 — DCO ER mode: DCO Constant (K) for DCORSEL 5
0x8C ADC14_CAL_TAG — ADC14 Calibration Tag
0x90 ADC14_CAL_LEN — ADC14 Calibration Length
0x94 ADC_GAIN_FACTOR
0x98 ADC_OFFSET
0xDC ADC14_REF1P2V_TS30C — ADC14 1.2V Reference Temp. Sensor 30C
0xE0 ADC14_REF1P2V_TS85C — ADC14 1.2V Reference Temp. Sensor 85C
0xE4 ADC14_REF1P45V_TS30C — ADC14 1.45V Reference Temp. Sensor 30C
0xE8 ADC14_REF1P45V_TS85C — ADC14 1.45V Reference Temp. Sensor 85C
0xEC ADC14_REF2P5V_TS30C — ADC14 2.5V Reference Temp. Sensor 30C
0xF0 ADC14_REF2P5V_TS85C — ADC14 2.5V Reference Temp. Sensor 85C
0xF4 REF_CAL_TAG — REF Calibration Tag
0xF8 REF_CAL_LEN — REF Calibration Length
0xFC REF_1P2V — REF 1.2V Reference
0x100 REF_1P45V — REF 1.45V Reference
0x104 REF_2P5V — REF 2.5V Reference
0x108 FLASH_INFO_TAG
0x10C FLASH_INFO_LEN — Flash Info Length
0x110 FLASH_MAX_PROG_PULSES — Flash Maximum Programming Pulses
0x114 FLASH_MAX_ERASE_PULSES — Flash Maximum Erase Pulses
0x118 RANDOM_NUM_TAG — 128-bit Random Number Tag
0x11C RANDOM_NUM_LEN — 128-bit Random Number Length
{0x11C+4i} RANDOM_NUM_{i} (i=1..4) — 32-bit Random Number {i}
0x130 BSL_CFG_TAG — BSL Configuration Tag
0x134 BSL_CFG_LEN — BSL Configuration Length
0x138 BSL_PERIPHIF_SEL — BSL Peripheral Interface Selection
0x13C BSL_PORTIF_CFG_UART — BSL Port Interface Configuration for UART
0x140 BSL_PORTIF_CFG_SPI — BSL Port Interface Configuration for SPI
0x144 BSL_PORTIF_CFG_I2C — BSL Port Interface Configuration for I2C
0x148 TLV_END — TLV End Word
